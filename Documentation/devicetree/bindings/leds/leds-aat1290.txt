## Documentation/devicetree/bindings/leds/leds-aat1290.txt
```
* Skyworks Solutions, Inc. AAT1290 Current Regulator for Flash LEDs

Required properties:

- compatible : Must be "skyworks,aat1290".
- gpios : Two gpio pins in order FLEN, EN/SET, and optional third
	  HW_FLASH_EN gpio for controlling the HW_FLASH_SW mux.

The LED connected to the device must be represented by a child node -
see Documentation/devicetree/bindings/leds/common.txt.

Required properties of the LED child node:
- label : see Documentation/devicetree/bindings/leds/common.txt
- flash-timeout-us : Maximum flash timeout in microseconds -
		     it can be calculated using following formula:
		     T = 8.82 * 10^9 * Ct.

Example:

aat1290 {
	compatible = "skyworks,aat1290";
	gpios = <&gpj1 1 0>, <&gpj1 2 0>, <&gpj1 0 0>;

	camera_flash: flash-led {
		label = "aat1290-flash";
		flash-timeout-us = <1940000>;
	};
};
```

## Documentation/devicetree/bindings/power_supply/charger-manager.txt
```
charger-manager bindings
~~~~~~~~~~~~~~~~~~~~~~~~

Required properties :
 - compatible : "charger-manager"
 - subnode <constraints> :
	- cm-charging-duration : limits of charging duration
	- cm-temp-* : threshold battery temperature for charging
		-cold : critical cold temperature of battery for charging
		-cold-in-minus : flag that cold temperature is in minus degrees
		-hot : critical hot temperature of battery for charging
		-diff : temperature difference to allow recharging
	- cm-fullbatt/recharging-* : full battery / recharging conditions
		-soc : full battery state-of-charge (%)
		-voltage : full battery voltage (uV)
		-capacity : full battery capacity (mAh)
		-status : charger status
		-count : number of trials for checking full battery
	- cm-top-off-time : top off mode duration
 - subnode <battery> :
	- cm-fuel-gauge : name of battery fuel gauge
	- cm-thermal-zone : name of battery thermal zone
	(It will try to use fuelgauge's unless it is defined.)
 - subnode <charger> :
	- cm-charger : name of charger
	- cm-regulator-name : name of charger regulator
	- cm-charger-max-cc : maximum charging current allowed
	- subnode <cable> :
		- cm-cable-name : name of charger cable
		- cm-cable-extcon : name of extcon dev
		- cm-cable-max : maximum current of cable

Optional properties :
 - cm-name : charger manager's name (default : "battery")
 - cm-poll-mode : polling mode (enum polling_modes)
 - cm-poll-interval : polling interval
 - cm-battery-stat : battery status (enum data_source)

Example :
	charger-manager@0 {
		compatible = "charger-manager";
		chg-reg-supply = <&charger_regulator>;

		cm-name = "battery";
		/* Always polling ON : 30s */
		cm-poll-mode = <1>;
		cm-poll-interval = <30000>;
		cm-battery-stat = <3>;

		constraints {
			cm-charging-duration = <21600000>; /* 6 hours */
			cm-temp-cold = <0>;
			cm-temp-hot = <600>;
			cm-temp-diff = <150>;

			cm-fullbatt-soc = <99>;
			cm-fullbatt-status;
			cm-top-off-time = <10000>; /* 10 secs */
			cm-recharging-voltage = <4300000>;
		};

		battery {
			cm-fuelgauge = <&fuelgauge>;
			cm-thermal-zone = "battery-thermal";
		};

		charger@0 {
			cm-charger = <&charger>;
			cm-regulator-name = "CHARGER";
			cable@0 {
				cm-cable-name = "USB";
				cm-cable-extcon = "extcon_dev";
				cm-cable-max = <450000>;
			};
			cable@1 {
				cm-cable-name = "TA";
				cm-cable-extcon = "extcon_dev";
				cm-cable-max = <2000000>;
			};
		};

	};
```

## Documentation/devicetree/bindings/rfkill/rfkill-gpio.txt
```
GPIO controlled RFKILL devices

Required properties:
- compatible	: Must be "rfkill-gpio".
- rfkill-name	: Name of RFKILL device
- rfkill-type	: Type of RFKILL device: 1 for WiFi, 2 for BlueTooth, etc.
		  See include/uapi/linux/rfkill.h for all valid values
- gpios		: At most two GPIO phandles
- gpio-names	: Shall be "reset" or "shutdown", matching gpios.
		  If both are provided, the "reset" GPIO is toggled first.

Example:

	rfkill_bt {
		compatible = "rfkill-gpio";
		rfkill-name = "bluetooth";
		rfkill-type = <2>;
		gpios = <&pio 7 18 0>;
		gpio-names = "reset";
	};
```

## Documentation/devicetree/bindings/sound/max98090.txt
```
max98090 audio CODEC

This device supports I2C mode only.

Required properties:

 - compatible : "maxim,max98090"

 - reg : the I2C address of the device for I2C

 - interrupt-parent: The parent interrupt controller

 - interrupts : The interrupt line the IRQ signal for the device is
    connected to.

Example:

max98090: max98090@10 {
	compatible = "maxim,max98090";
	reg = <0x10>;
	interrupt-parent = <&gpx0>;
	interrupts = <1 0>;
};
```

## Documentation/devicetree/bindings/sound/samsung,odroidX2-max98090.txt
```
Samsung Odroid audio complex

Required properties:
 - compatible : 
	"samsung,odroidx2-audio" : for odroidx2 platform
	"samsung,odroidu3-audio" : for odroidu3 platform
 - samsung,i2s-controller: The phandle of the Samsung I2S0 controller
 - samsung,audio-codec: The phandle of the max98090 audio codec

Example:

sound {
	compatible = "samsung,odroidx2-audio";
	samsung,i2s-controller = <&i2s0>;
	samsung,audio-codec = <&max98090>;
};
```

## packaging/image.its
```
/dts-v1/;
/ {
	description = "Single Linux kernel and with multiple FDT blobs";
	#address-cells = <1>;
	images {
		kernel@1 {
			description = "Vanilla Linux kernel";
			data = /incbin/("arch/arm/boot/zImage");
			type = "kernel";
			arch = "arm";
			os = "linux";
			compression = "none";
			load = <0x40008000>;
			entry = <0x40008000>;
			hash@1 {
				algo = "crc32";
			};
		};
		fdt@0 {
			description = "FDT for exynos4210-trats";
			data = /incbin/("arch/arm/boot/dts/exynos4210-trats.dtb");
			type = "flat_dt";
			arch = "arm";
			compression = "none";
			hash@1 {
				algo = "crc32";
			};
		};
		fdt@1 {
			description = "FDT for exynos4412-trats2";
			data = /incbin/("arch/arm/boot/dts/exynos4412-trats2.dtb");
			type = "flat_dt";
			arch = "arm";
			compression = "none";
			hash@1 {
				algo = "crc32";
			};
		};
		fdt@2 {
			description = "FDT for exynos4412-odroidx2";
			data = /incbin/("arch/arm/boot/dts/exynos4412-odroidx2.dtb");
			type = "flat_dt";
			arch = "arm";
			compression = "none";
			hash@1 {
				algo = "crc32";
			};
		};
		fdt@3 {
			description = "FDT for exynos4412-odroidu3";
			data = /incbin/("arch/arm/boot/dts/exynos4412-odroidu3.dtb");
			type = "flat_dt";
			arch = "arm";
			compression = "none";
			hash@1 {
				algo = "crc32";
			};
		};
	};
	configurations {
		default = "odroidu3@2";
		trats@0 {
			description = "Boot Linux kernel with Exynos4210 Trats FDT";
			kernel = "kernel@1";
			fdt = "fdt@0";
		};
		trats2@1 {
			description = "Boot Linux kernel with Exynos4412 Trats2 FDT";
			kernel = "kernel@1";
			fdt = "fdt@1";
		};
		odroidx2@2 {
			description = "Boot Linux kernel with OdroidX2 FDT";
			kernel = "kernel@1";
			fdt = "fdt@2";
		};
		odroidu3@3 {
			description = "Boot Linux kernel with OdroidU3 FDT";
			kernel = "kernel@1";
			fdt = "fdt@3";
		};
	};
};
```

## security/kprobes/Kconfig
```kconfig
config SECURITY_PROBES
	tristate "Security probes"
	depends on MODULES
	depends on SECURITY
	select CONFIGFS
	select KPROBES
	default n
	help
	  This selects the Security probes.
	  Security probes are useful for debugging security functions.
	  If you are unsure how to answer this question, answer N.
```
